## config/boards/shields/cck_ball/Kconfig.defconfig
```kconfig
if SHIELD_CCK_BALL_LEFT

config ZMK_KEYBOARD_NAME
	default "WK CCK BALL LEFT"

endif

if SHIELD_CCK_BALL_RIGHT

config ZMK_KEYBOARD_NAME
	default "WK CCK BALL RIGHT"

config ZMK_SPLIT_BLE_ROLE_CENTRAL
	default y

endif

if SHIELD_CCK_BALL_LEFT || SHIELD_CCK_BALL_RIGHT

config ZMK_SPLIT
	default y

endif
```
